/*
 * detector.c
 *
 *  Created on: Dec 22, 2014
 *      Author: hutch
 */

#include "supportFiles/interrupts.h"
#include <stdint.h>
#include "isr.h"
#include "stdio.h"
#include "detector.h"
#include "filter.h"
#include "lockoutTimer.h"
#include "hitLedTimer.h"
#include "supportFiles/switches.h"

#define TRANSMITTER_TICK_MULTIPLIER 3	// Call the tick function this many times for each ADC interrupt.
#define FILTER_QUANTITY 10
#define FUDGE_FACTOR 20
#define ACCESS_POWERVAL
#define ACCESS_PLAYERNUM
#define DETECTOR_TEST_MODE false
#define DETECTOR_SCALEADC 2048
#define DETECTOR_SHIFTADC 1
#define TEST_DATA_COUNT 5000
#define TEST_ITERATIONS 2000
double testDataA[FILTER_QUANTITY] = {150,20,40,10,15,30,35,15,25,80};
double testDataB[FILTER_QUANTITY] = {50,55,65,70,150,10,25,30,30,45};
double inputTest[FILTER_QUANTITY][2];
double expectedDataA[FILTER_QUANTITY] = {10,15,15,20,25,30,35,40,80,150};
double expectedDataB[FILTER_QUANTITY] = {10,25,30,30,45,50,55,65,70,150};


static double InputTestData[TEST_DATA_COUNT] = {1181,1421,1518,1394,1223,1305,1300,1100,1157,1054,1436,1137,1134,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1076,1029};
//static double InputTestData[TEST_DATA_COUNT] = {
//		1181,
//		1421,
//		1518,
//		1394,
//		1223,
//		1305,
//		1300,
//		1100,
//		1157,
//		1054,
//		1436,
//		1137,
//		1134,
//		1305,
//		1066,
//		1059,
//		1219,
//		1372,
//		1037,
//		1266,
//		1102,
//		1127,
//		 977,
//		1387,
//		1496,
//		1029,
//		1261,
//		1337,
//		1326,
//		1346,
//		1314,
//		1170,
//		1224,
//		1099,
//		1544,
//		1144,
//		1071,
//		1276,
//		1402,
//		1204,
//		1270,
//		1238,
//		1066,
//		1325,
//		1076,
//		1136,
//		1262,
//		1215,
//		1275,
//		1287,
//		1088,
//		1006,
//		1422,
//		1308,
//		1201,
//		1443,
//		 966,
//		1254,
//		1244,
//		1507,
//		1283,
//		1364,
//		1494,
//		1069,
//		 945,
//		1236,
//		1183,
//		1223,
//		1177,
//		 986,
//		1258,
//		1176,
//		1337,
//		1376,
//		1308,
//		1045,
//		1098,
//		1350,
//		1017,
//		1176,
//		1120,
//		1123,
//		1116,
//		1161,
//		1313,
//		1138,
//		 897,
//		 989,
//		1422,
//		1332,
//		1199,
//		1305,
//		1356,
//		1202,
//		1309,
//		1268,
//		1261,
//		1274,
//		1051,
//		1310,
//		1023,
//		1109,
//		1164,
//		1281,
//		1356,
//		1231,
//		1073,
//		1207,
//		1373,
//		1156,
//		1243,
//		1453,
//		1208,
//		1451,
//		1313,
//		1249,
//		1183,
//		1397,
//		1269,
//		1043,
//		1232,
//		1230,
//		1252,
//		1386,
//		1480,
//		1303,
//		1419,
//		1084,
//		1343,
//		1318,
//		1361,
//		1358,
//		1025,
//		1277,
//		1350,
//		1049,
//		1195,
//		1133,
//		1106,
//		1371,
//		 953,
//		1129,
//		1300,
//		1395,
//		1520,
//		1220,
//		1335,
//		1301,
//		1113,
//		1400,
//		1242,
//		1395,
//		1111,
//		1287,
//		1240,
//		1528,
//		1422,
//		1208,
//		1009,
//		1315,
//		1261,
//		1456,
//		 941,
//		1327,
//		1149,
//		1345,
//		1064,
//		1129,
//		1173,
//		1259,
//		1535,
//		1285,
//		1313,
//		1357,
//		1074,
//		1200,
//		1181,
//		1104,
//		1409,
//		1295,
//		1450,
//		1388,
//		1235,
//		1397,
//		1305,
//		1724,
//		1310,
//		1307,
//		1153,
//		1111,
//		1378,
//		1124,
//		1205,
//		 999,
//		 970,
//		1349,
//		1307,
//		1147,
//		1381,
//		1180};

uint32_t elementCount;
uint32_t rawAdcValue;
uint32_t decimateCount;
uint16_t placeIndex;
uint16_t powerMaxIndex;
double threshold;
double scaledAdcValue;
double powerTemp;
double playerTemp;
uint32_t hitCounts[FILTER_QUANTITY];
int32_t playerHit;

bool detector_hitDetectedFlag;
bool detector_hitDetectAlert;
bool detector_test_mode;
//double power[FILTER_QUANTITY][2];  // [power][player]
double power[FILTER_QUANTITY];
void detector_init() {
	printf("zoinks!\r\n");
	filter_init();
	elementCount = 0;
	rawAdcValue = 0;
	playerHit = 0;
	decimateCount = 0;
	detector_test_mode = false;
	detector_clearHit();
	detector_hitDetectAlert = false;
	for (int i = 0 ; i < FILTER_QUANTITY ; i++) {
		hitCounts[i] = 0;
		power[i] = i;
		filter_computePower((uint16_t)i, true, false);
	}
}

//void detector_hitDetectAlgorithm() {
//	// We sort the normalized power values with an insertion sort
//	for( int k = 1 ; k < FILTER_QUANTITY ; k++) {
//		placeIndex = k;
//		while((placeIndex > 0) && (power[placeIndex - 1] > power[placeIndex])) {
//			powerTemp = power[placeIndex];
//			power[placeIndex] = power[placeIndex-1];
//			power[placeIndex-1] = powerTemp;
//			placeIndex--;
//		}
//	}
//
//	// Multiply the median value with a fudge factor
//
//	threshold = FUDGE_FACTOR * power[4];
//
//	if(power[9] >= threshold) {
//		detector_hitDetectAlert = true;
//	}
//
//	if(detector_hitDetectAlert) {
//		// Start the lockoutTimer
//		lockoutTimer_start();
//
//		// Start the hitLedTimer
//		hitLedTimer_start();
//		// increment detector_hitArray at the index of the frequency of the IIR-filter output where you detect the hit
//		hitCounts[playerHit] += 1;
//		// Set detector_hitDetectedFlag to true
//		detector_hitDetectedFlag = true;
//	}
//
//}

void detector_hitDetectAlgorithmTest() {
	// We sort the normalized power values with an insertion sort
	for( int k = 1 ; k < FILTER_QUANTITY ; k++) {
		placeIndex = k;
		while((placeIndex > 0) && (inputTest[placeIndex - 1][0] >= inputTest[placeIndex][0])) {
			powerTemp = inputTest[placeIndex][0];
			playerTemp = inputTest[placeIndex][1];
			inputTest[placeIndex][0] = inputTest[placeIndex-1][0];
			inputTest[placeIndex][1] = inputTest[placeIndex-1][1];
			inputTest[placeIndex-1][0] = powerTemp;
			inputTest[placeIndex-1][1] = playerTemp;
			placeIndex--;
		}
	}


	// Multiply the median value with a fudge factor

	threshold = FUDGE_FACTOR * inputTest[4][0];

	if(inputTest[9][0] >= threshold) {
		detector_hitDetectAlert = true;
		playerHit = inputTest[9][1];
	}
	printf("max: %lf and threshold: %lf\r\n",inputTest[9][0],threshold);
	if(detector_hitDetectAlert) {
		// Start the lockoutTimer
		lockoutTimer_start();

		// Start the hitLedTimer
		hitLedTimer_start();
		// increment detector_hitArray at the index of the frequency of the IIR-filter output where you detect the hit
		hitCounts[playerHit] += 1;
		// Set detector_hitDetectedFlag to true
		detector_hitDetectedFlag = true;
	}

}

void detector() {
	// Here we query the adcQueue to see how many elements it contains


	// Statement used to activate test mode when detector_runTest is called
	if(detector_test_mode) {
		elementCount = TEST_DATA_COUNT;
	}
	else {
		elementCount = isr_adcBufferElementCount();  //We assign that number to elementCount
	}

	// We use the while loop to keep track of decimation
	while(isr_adcBufferElementCount() > FILTER_QUANTITY) {
		// Repeat the following  steps elementCount times
		for(uint32_t i = 0 ; i <  FILTER_QUANTITY ; i++ ) {
			// Disable the interrupts
			interrupts_disableArmInts();
			// Pop a value from the adcQueue and place it in rawAdcValue

			if(detector_test_mode) {
				scaledAdcValue = InputTestData[i];
				printf("test data activated\r\n");
			}
			else {
				// Scale the integer value contained in rawAdcValue to a double that is between -1.0 and 1.0
				// Save the value to scaledAdcValue
				rawAdcValue = isr_removeDataFromAdcBuffer();
				scaledAdcValue = (double) rawAdcValue;
				// For the ZYBO board we scale by 2048 and shift by 1.
				scaledAdcValue =(scaledAdcValue / DETECTOR_SCALEADC) - DETECTOR_SHIFTADC;
			}
			// Re-enable the interrupts by invoking interrupts_enableArmInts()
			interrupts_enableArmInts();

			//invoke filter_addNewInput(scaledAdcValue)
			filter_addNewInput(scaledAdcValue);

		}
		//perform the decimating FIR filter, IIR filter and power computation for all 10 channels.
		// Invoke the filters after filter_addNewInput() has been called 10 times

		filter_firFilter();
		for(int j = 0 ; j < FILTER_QUANTITY ; j++) {
			filter_iirFilter((uint16_t)j);
			filter_computePower((uint16_t)j, false, false);
		}

		// if the lockoutTimer isn't running run the algorithm.  Otherwise if a hit is detected:
		if (!lockoutTimer_running()) {
			// We implement the hit detection algorithm to see if we register a hit
			//	 filter_getNormalizedPowerValues(power, &powerMaxIndex);
			for(int i = 0 ; i < FILTER_QUANTITY ; i++) {
				power[i] = filter_getCurrentPowerValue(i);	// Store the power
			}

			// We sort the normalized power values with an insertion sort
			for( int k = 1 ; k < FILTER_QUANTITY ; k++) {
				placeIndex = k;
				while((placeIndex > 0) && (power[placeIndex - 1] > power[placeIndex])) {
					powerTemp = power[placeIndex];
					power[placeIndex] = power[placeIndex-1];
					power[placeIndex-1] = powerTemp;
					placeIndex--;
				}
			}


			// Multiply the median value with a fudge factor
			threshold = FUDGE_FACTOR * power[4];

			if(power[9] > threshold) {

				for (int i = 0; i < FILTER_QUANTITY; i++){
					if (power[9] == filter_getCurrentPowerValue(i))
						playerHit = i;
				}

				// Start the lockoutTimer
				lockoutTimer_start();

				// Start the hitLedTimer
				hitLedTimer_start();

				// increment detector_hitArray at the index of the frequency of the IIR-filter output where you detect the hit
				hitCounts[playerHit] += 1;
				detector_hitDetectAlert = true;

				// Set detector_hitDetectedFlag to true
				detector_hitDetectedFlag = true;
				detector_hitDetectAlert =false;  //reset the alert
			}
		}
	}
}



bool detector_hitDetected() {

	return detector_hitDetectedFlag;
}

void detector_clearHit() {
	detector_hitDetectedFlag = false;
}

void detector_getHitCounts(detector_hitCount_t hitArray[]) {
	for(int i = 0 ; i < FILTER_QUANTITY; i++) {
		hitArray[i] = hitCounts[i];
	}

}


void detector_runTest() {
	isr_init();
	interrupts_initAll(false);
	detector_test_mode = true;
	// First we want to do the isolated test of our hit detection algorithm

	bool passTest = true;  // Be optimistic
	// We take our designated test array and assign it values
	for(int i = 0 ; i < FILTER_QUANTITY ; i++) {
		inputTest[i][0] = testDataB[i];	// Store the power
		inputTest[i][1] = i;	// Associate the player to that power value
	}

	// Pass the array through the detector algorithm
	detector_hitDetectAlgorithmTest();

	// For test A, there should be a hit detected.
	if (detector_hitDetectedFlag) {
		passTest = false;
		printf("fail\r\n");
	}

	for(int i = 0 ; i < FILTER_QUANTITY ; i++) {

		if(inputTest[i][0] != expectedDataB[i]) {
			passTest = false;
			printf("%lf vs %lf\r\n",inputTest[i][0], expectedDataB[i]);

		}
	}

	detector_clearHit();	// Reset for test B



	if(passTest) {
		printf("Passed Isolated Test\n\r");
	}
	else {
		printf("Failed Isolated Test\n\r");
	}




	// Comprehensive test
	detector_init();
	detector_test_mode = true;
		detector();

//	for(int i = 0 ; i < FILTER_QUANTITY ; i++) {
//		printf("player %d had %ld hits\r\n",i,hitCounts[i]);
//	}
}




