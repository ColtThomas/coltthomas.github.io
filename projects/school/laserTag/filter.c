/*
 * filter.c
 *
 *  Created on: Feb 7, 2015
 *      Author: coltmt
 */

#include "filter.h"
#include <stdio.h>
#include <stdlib.h>
#include "supportFiles/intervalTimer.h"
#include "histogram.h"
#include <math.h>
#include "supportFiles/utils.h"

#define FILTER_IIRFILTERS 10
#define FIR_FILTER_TAP_COUNT 201
#define FIR_COEFFICIENT_COUNT 201
#define X_QUEUE_SIZE FIR_COEFFICIENT_COUNT  // Sample of 200ms
#define Y_QUEUE_SIZE IIR_COEFFICIENT_COUNT
#define IIR_COEFFICIENT_COUNT 11
#define Z_QUEUE_SIZE (Y_QUEUE_SIZE - 1)
#define EPSILON_NEG -0.000001 // Error tolerance in testing
#define EPSILON_POS 0.000001 // Error tolerance in testing
#define TEST_DATA_COUNT 44
#define FIR_TEST_DATA_COUNT 200
#define OUTPUT_QUEUE_SIZE 2000
static queue_t xQueue;
static queue_t yQueue;
static queue_t zQueue[FILTER_IIRFILTERS];
static queue_t outputQueue[FILTER_IIRFILTERS];
double currentPowerValue[FILTER_IIRFILTERS];
double normalizedArray[FILTER_IIRFILTERS];
// These queues are for debugging purposes
queue_t aSum;
queue_t bSum;

// All of my test data is below
//static double firCoefficients[FIR_COEFFICIENT_COUNT] = {1.18253876945993e-06,6.41366477248988e-06,1.8654049888775e-05,3.90896593467756e-05,6.52008802062904e-05,8.7899458360922e-05,8.99146634834456e-05,4.68449475994845e-05,-6.76819360498934e-05,-0.000272167104106897,-0.000563739415273607,-0.000904060973223367,-0.0012096186640746,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6.41366477248988e-06,1.18253876945993e-06};
static double firCoefficients[FIR_COEFFICIENT_COUNT]={3.4238617549002e-06,2.37432847467417e-06,2.50762230700877e-06,1.82299287516409e-06,-9.20527210925693e-21,-3.09733387546318e-06,-7.28712512904654e-06,-1.19713211075283e-05,-1.61147095629514e-05,-1.83372885204375e-05,-1.71379102092084e-05,-1.12381630707016e-05,1.73125519315036e-19,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2.37432847467417e-06,3.4238617549002e-06};
static double firInputTestData[FIR_TEST_DATA_COUNT] = {
		1181,
		1421,
		1518,
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		1381,
		1180};

static double firOutputTestData[FIR_TEST_DATA_COUNT] ={0.00139657828673217,0.00925492568771311,0.0329393444123916,0.084056694749758,0.171252386794458,0.291188684641645,0.417281305129742,0.489202770061016,0.409082783588186,0.0514374945526552,-0.707489966128739,-1.94020505687107,-3.6043930743777,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2504.8235536719,2483.58312261274};

static double iirCoefficientsB[FILTER_IIRFILTERS][IIR_COEFFICIENT_COUNT] = {

		{5.53774282957553e-08,8.63013648449047e-09,-1.14197658483915e-06,-1.13939341744732e-07,3.72476608905631e-06,2.22127075317958e-07,-3.57641058827856e-06,-1.02923825030645e-07,1.01083279980851e-06,7.04199011677163e-09,-4.51866900890529e-08},
		{5.53774282957553e-08,7.23128326703533e-09,-1.51430232867565e-06,-1.24345424035908e-07,5.51142373959059e-06,2.59290356889146e-07,-5.29183762641806e-06,-1.12322786872885e-07,1.34037456002849e-06,5.90055851255122e-09,-4.51866900890529e-08},
		{5.53774282957553e-08,5.29977330815175e-09,-1.92045891839663e-06,-1.1421696013835e-07,7.7466127220412e-06,2.53891852708587e-07,-7.43789504033612e-06,-1.0317295922446e-07,1.69985966068909e-06,4.32449142886738e-09,-4.51866900890529e-08},
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		{5.53774282957553e-08,-8.39873793657332e-09,-1.20810002397999e-06,1.16840164128305e-07,4.02374244204715e-06,-2.30719169920443e-07,-3.86346853624904e-06,1.05543978096609e-07,1.06935798880496e-06,-6.85317429787978e-09,-4.51866900890529e-08}

};


static double iirCoefficientsA[FILTER_IIRFILTERS][IIR_COEFFICIENT_COUNT-1] = {
		{-7.35324580430287,26.2311138204615,-58.8948353608113,91.6454942368739,-102.950813933996,84.4877620596799,-50.0539658433557,20.5517728765454,-5.31097294132233,0.665817942343443},
		{-6.16136296785258,19.7851949195999,-41.3987111276161,61.9584760111217,-68.6830735503277,57.1197667824781,-35.1846134167316,15.5016326769979,-4.45012078676633,0.665817942343443},
		{-4.51563378075868,12.7535768224597,-23.9850650844082,34.3203944953708,-37.1408210080598,31.6404936655824,-20.3851807573777,9.99261871539083,-3.26147247906451,0.665817942343443},
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		{7.15608433360639,25.0863465482443,55.6758904825641,86.0692694091044,96.4769750294261,79.3471383460919,47.3183040890217,19.6548898549831,5.16857062487486,0.665817942343443}

};

static double iirTestInput[TEST_DATA_COUNT] = {
		0,0.00139657828673217,0.00925492568771311,0.0329393444123916,0.084056694749758,0.171252386794458,0.291188684641645,0.417281305129742,0.489202770061016,0.409082783588186,0.0514374945526552,-0.707489966128739,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2232.50591119471
};

static double iirTestOutput[FILTER_IIRFILTERS][TEST_DATA_COUNT] = {
		{0,7.73389139329197e-11,1.09325868926623e-09,6.31942176854156e-09,1.65568120786521e-08,-9.97923043836337e-09,-2.75090181863618e-07,-1.31882775715397e-06,-4.05891737307402e-06,-9.25860624465743e-06,-1.59760362038619e-05,-1.91003408659166e-05,-7.30075393585411e-06,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0.172845041478841,0.179351223732803},
		{0,7.73389139329197e-11,9.99126157130057e-10,4.40199283851426e-09,1.26072492518977e-09,-7.59982129062288e-08,-4.30201406725091e-07,-1.37134485414027e-06,-2.92353508397895e-06,-3.96232544533572e-06,-1.41367820715485e-06,9.17967528219798e-06,3.04574262508909e-05,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0.0147772146679503,0.0121646305017987},
		{0,7.73389139329197e-11,8.69149744303324e-10,2.12948813114596e-09,-1.27176034672124e-08,-1.09962297051287e-07,-3.86343626892054e-07,-7.57159437603124e-07,-5.98541222355575e-07,1.2333984333186e-06,5.35954524736293e-06,1.01534359152097e-05,1.12135832778755e-05,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0.00255911343619606,0.0020706296373334},
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		{0,7.73389139329197e-11,-5.26593017577947e-11,-1.50415616611669e-09,1.13948012210131e-09,1.53925890109934e-09,-4.88036264468655e-09,9.87579149360102e-09,4.44189018437323e-10,-7.95960680003235e-09,2.68466773360215e-08,-2.50739367672287e-08,-3.46806424455496e-09,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2.21134430411745e-06,-3.04258909979518e-07}
};


static double powerTestForce[FILTER_IIRFILTERS][TEST_DATA_COUNT] = {
		{3.066659564651520E-15,	1.759845574504820E-13,	3.904843749066620E-13,	1.935382498916190E-11,	4.616013492613470E-10,	2.515268922508110E-09,	4.627260641433020E-09,	5.332820511935940E-09,	4.233512084836640E-08,	1.883215995168090E-07,	3.695750641431060E-07,	3.890035101758090E-07,	6.502388110697400E-07,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5.21332108E-03,5.23926808E-03},
		{3.066659564651520E-15,
				1.244713225256350E-13,
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						4.70899785E-03,
						5.95301364E-03}

};

static double powerTestPassive[FILTER_IIRFILTERS][TEST_DATA_COUNT]= {
		{5.537743136241490E-08,	4.712115799669890E-07,	9.343528715538950E-07,	-3.420320172861780E-06,	-2.444957887087140E-05,-6.976537661382250E-05,-1.157217293650090E-04,-8.916075882296960E-05,1.032353578811010E-04,4.854261116696080E-04,9.112001067815100E-04,1.050424242435800E-03,5.395542211219830E-04,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-5.01197763E-02,-4.53204562E-02},
		{5.537743136241490E-08,
				4.038092689238320E-07,
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								1.73258021E-02,
								-1.72598180E-02}
};

//-------Private functions

void initXQueue() {
	  uint32_t j = 0;

	  queue_init(&xQueue, X_QUEUE_SIZE);
	  for(j = 0 ; j < X_QUEUE_SIZE ; j++) {
		  queue_overwritePush(&xQueue, 0);
	  }
}

void initYQueue() {
	uint32_t j = 0;

	queue_init(&yQueue, Y_QUEUE_SIZE);
	for(j = 0 ; j < Y_QUEUE_SIZE ; j++) {
		queue_overwritePush(&yQueue, 0);
	}

}

void initZQueues() {
	uint32_t i = 0;
	uint32_t j = 0;

	queue_init(&bSum, IIR_COEFFICIENT_COUNT);
	queue_init(&aSum, IIR_COEFFICIENT_COUNT-1);
	for(i = 0;i < FILTER_IIRFILTERS;i++) {
		queue_init(&zQueue[i], Z_QUEUE_SIZE);

		for(j = 0 ; j < Z_QUEUE_SIZE ; j++) {
			queue_overwritePush(&zQueue[i], 0);
			queue_overwritePush(&aSum, 0);
			queue_overwritePush(&bSum, 0);

		}
	}

}

void initPower() {
	for(int i = 0 ; i < FILTER_IIRFILTERS ; i++ ) {
		currentPowerValue[i] = 0;
		queue_init(&outputQueue[i], OUTPUT_QUEUE_SIZE);
		for(int j = 0 ; j < OUTPUT_QUEUE_SIZE ; j++ ) {
			queue_overwritePush(&(outputQueue[i]),0);
		}
//		filter_computePower(i, true, false);	// Does a force compute to init the functionallity
	}	
}
//-------Public functions

void filter_init() {

	initXQueue();
	initYQueue();
	initZQueues();
	initPower();

}

// Print out the contents of the xQueue for debugging purposes.
void filter_printXQueue() {
	uint32_t j = 0;
	printf("xQueue contents: \r\n");
	for(j = 0 ; j < X_QUEUE_SIZE ; j++) {
		printf(" %lf ", queue_readElementAt(&xQueue, j));
	}
	printf("\r\n");
}

// Print out the contents of yQueue for debugging purposes.
void filter_printYQueue() {
	uint32_t j = 0;
	printf("yQueue contents: \r\n");
	  for(j = 0 ; j < Y_QUEUE_SIZE ; j++) {
			printf(" %lf \r\n", queue_readElementAt(&yQueue, j));
	  }
	  printf("\r\n");
}

// Print out the contents of the the specified zQueue for debugging purposes.
void filter_printZQueue(uint16_t filterNumber) {
	uint32_t j = 0;
	printf("zQueue %d contents: \r\n",filterNumber);
	  for(j = 0 ; j < Z_QUEUE_SIZE ; j++) {
			printf(" %lf \r\n", queue_readElementAt(&(zQueue[filterNumber]), j));
	  }
	  printf("\r\n");
}

void filter_printOutputQueue(uint16_t filterNumber) {
	uint32_t j = 0;
	printf("outputQueue %d contents: \r\n",filterNumber);
	  for(j = 0 ; j < OUTPUT_QUEUE_SIZE ; j++) {
			printf(" %lf \r\n", queue_readElementAt(&(outputQueue[filterNumber]), j));
	  }
	  printf("\r\n");
}

// These print functions are for debugging purposes only
void filter_printBsum() {
	uint32_t j = 0;
	printf("bSum contents: \r\n");
	for(j = 0 ; j <Y_QUEUE_SIZE ; j++) {
			printf(" %lf ", queue_readElementAt(&bSum, j));
	}
	printf("\r\n");
}
void filter_printAsum() {
	uint32_t j = 0;
	printf("aSum contents: \r\n");
	for(j = 0 ; j < Z_QUEUE_SIZE ; j++) {
			printf(" %lf ", queue_readElementAt(&aSum, j));
	}
	printf("\r\n");
}


// Print for IIR and FIR debugging
void filter_printIIR(uint16_t filterNumber) {
	uint32_t j = 0;
	printf("yQueue	zQueue %d	aSum	bSum\r\n",filterNumber);
	for(j = 0 ; j < X_QUEUE_SIZE ; j++) {
		  printf(" %lf ", queue_readElementAt(&yQueue, j));
		  printf(" %lf ", queue_readElementAt(&zQueue[filterNumber], j));
		  printf(" %lf ", queue_readElementAt(&aSum, j));
		  printf(" %lf ", queue_readElementAt(&bSum, j));
		  printf("\r\n");
	}
}

void filter_printFIR() {
	uint32_t j = 0;
		printf("xQueue	yQueue	\r\n");
		  for(j = 0 ; j < X_QUEUE_SIZE ; j++) {
				printf(" %lf ", queue_readElementAt(&xQueue, j));
				printf(" %lf ", queue_readElementAt(&yQueue, j));
				printf("\r\n");
		  }
}


// Use this to copy an input into the input queue (x_queue).
void filter_addNewInput(double x) {
	queue_overwritePush(&xQueue, x);
}

// Invokes the FIR filter. Returns the output from the FIR filter. Also adds the output to the y_queue for use by the IIR filter.
double filter_firFilter() {
	uint32_t i;
	double firOutput = 0;
	for(i=0;i<FIR_COEFFICIENT_COUNT;i++) {
		firOutput += firCoefficients[i]*queue_readElementAt(&xQueue,X_QUEUE_SIZE-i-1);
	}
//	printf("fir output: %lf\r\n",firOutput);
	queue_overwritePush(&yQueue,firOutput);
	return firOutput;
}

// Use this to invoke a single iir filter. Uses the y_queue and z_queues as input. Returns the IIR-filter output.
double filter_iirFilter(uint16_t filterNumber) {

	double bsum = 0;
	double asum = 0;
	double returnVal = 0;


	bsum = 0;
	// Bsum calculation with B coefficients
	for(int j=0; j < Y_QUEUE_SIZE;j++) {
		bsum += iirCoefficientsB[filterNumber][Y_QUEUE_SIZE - j - 1]*queue_readElementAt(&yQueue, (j));  // IIR_COEFFICIENT_COUNT - i -1  AND i
	}

	queue_overwritePush(&bSum,bsum);	// This is used for our test function

	asum = 0;
	// Asum calculation with B coefficients
	for(int k=0; k < Z_QUEUE_SIZE;k++) {
		asum += iirCoefficientsA[filterNumber][k]*queue_readElementAt(&(zQueue[filterNumber]),(Z_QUEUE_SIZE-k-1));
	}

	queue_overwritePush(&aSum,asum);	// This is used for our test function

	returnVal = bsum - asum;	// We push this value onto our zQueue and our outputQueue
	queue_overwritePush(&(zQueue[filterNumber]),returnVal); // We assume that the number passed in is ok
	queue_overwritePush(&(outputQueue[filterNumber]),returnVal);

	return returnVal;
}

// Use this to compute the power for values contained in a queue.
// If force == true, then recompute everything from scratch.
double filter_computePower(uint16_t filterNumber, bool forceComputeFromScratch, bool debugPrint) {

	// Before calculating anything we grab the necessary values and initiallize returnPower
	double returnPower = 0;
	double newPower =  queue_readElementAt(&(outputQueue[filterNumber]),OUTPUT_QUEUE_SIZE - 1);
	double oldPower = queue_readElementAt(&(outputQueue[filterNumber]),0);

	// We reiterate over the entire outputQueue and find the sum of squares
	if(forceComputeFromScratch) {
		for(int i = 0 ; i < OUTPUT_QUEUE_SIZE ; i++) {
			returnPower += queue_readElementAt(&(outputQueue[filterNumber]),i) *  queue_readElementAt(&(outputQueue[filterNumber]),i);
		}
		currentPowerValue[filterNumber] = returnPower;
	}
	// Otherwise we just subtract the oldest value and add the newest value
	else {
		currentPowerValue[filterNumber] += (newPower * newPower);
		currentPowerValue[filterNumber] -= (oldPower * oldPower);
	}
	return returnPower;
}

double filter_getCurrentPowerValue(uint16_t filterNumber) {
	return currentPowerValue[filterNumber];
}

// Uses the last computed-power values, scales them to the provided lowerBound and upperBound args, returns the index of element containing the max value.
// The caller provides the normalizedArray that will contain the normalized values. indexOfMaxValue indicates the channel with max. power.
void filter_getNormalizedPowerValues(double normalizedArray[], uint16_t* indexOfMaxValue) {
	double maxPower = 0;
	double currentPower = 0;
	uint16_t indexMax;
	// We find the max power and its index with a simple search algorithm
	for(int i = 0 ; i < FILTER_IIRFILTERS ; i++) {
		currentPower = currentPowerValue[i];
		if(currentPower > maxPower) {
			indexMax = (uint16_t) i;
			maxPower = currentPower;
		}
	}
	*indexOfMaxValue = indexMax;
	// Then we normalize the power values
	for(int j = 0 ; j < FILTER_IIRFILTERS ; j++) {
		normalizedArray[j] = currentPowerValue[j]/currentPowerValue[indexMax];
	}
}


// Pushes a single 1.0 through the xQueue. Golden output data is just the coefficients in reverse order.
bool filter_runFirOneTest() {
    bool success = true;             // Be optimistic.
    filter_init();
    filter_addNewInput(1.0);    // Place a single 1.0 in the xQueue.
    for (int i=0; i<FIR_FILTER_TAP_COUNT; i++) {
        double firValue = filter_firFilter();        // Run the FIR filter.
        double firGoldenOutput =  firCoefficients[FIR_FILTER_TAP_COUNT-i-1]; // Golden output is the coefficient.
        if (firValue != firGoldenOutput) {
            success = false;
            printf("Output from FIR Filter(%le) does not match test-data(%le).\n\r", firValue, firGoldenOutput);
        }
        filter_addNewInput(0.0);
    }
    return success;
}

// Pushes a series of 1.0 though xQueue. Golden output data is the sum of the coefficients in reverse order.
bool filter_runFirOnesTest() {
    bool success = true;             // Be optimistic.
    filter_init();
    filter_addNewInput(1.0);    // Place a single 1.0 in the xQueue.
    double firGoldenOutput = 0.0;
    for (int i=0; i<FIR_FILTER_TAP_COUNT; i++) {
        double firValue = filter_firFilter();        // Run the FIR filter.
        firGoldenOutput +=  firCoefficients[FIR_FILTER_TAP_COUNT-i-1]; // Golden output is coefficient sum.
        if (firValue != firGoldenOutput) {
            success = false;
            printf("Output from FIR Filter(%le) does not match test-data(%le).\n\r", firValue, firGoldenOutput);
        }
        filter_addNewInput(1.0);  // Plae another 1 in the xQueue.
    }
    return success;
}




//bool filter_runTest() {
//	printf("\r\n-----Filter.c Test-----\r\n");
//
//	//Fir Filter Test
//	filter_init();
//	double IIR_error;
//	double FIR_out;
//	bool FIR_pass = true;
//	uint32_t tally_s = 0;
//	uint32_t tally_f = 0;
//	double FIR_error;
//
//	// Test 1 with force compute
//	for(int i=0 ; i < FIR_TEST_DATA_COUNT ; i++) {
//
//		filter_addNewInput(firInputTestData[i]);
//		FIR_out = filter_firFilter();
//		FIR_error = FIR_out - firOutputTestData[i];
//
//		if(!(FIR_error >= EPSILON_NEG && FIR_error < EPSILON_POS)) {
//			printf("FAIL! \r\n");
//			printf("FIR output is %lf and it should be %lf. At index %d\n\r",FIR_out, firOutputTestData[i], i);
//			FIR_pass = false;
//		}
//
//			if (FIR_pass) {
//				tally_s++;
//			}
//			else {
//				tally_f++;
//			}
//	}
//
//
//	printf("FIR filter successes: %ld fails: %ld\r\n\r\n",tally_s,tally_f);
//
//	// IIR filters test
//
//	filter_init();
//	IIR_error = 0;
//	double output;
//	double powerForce;
//	double powerPassive;
//	double powerForce_error;
//	double powerPassive_error;
//	tally_s= 0;
//	tally_f = 0;
//	uint32_t tally_pf_s = 0; // Tallies of force compute power values successes
//	uint32_t tally_pf_f = 0; // Tallies of force compute power values fails
//	uint32_t tally_pp_s = 0; // Tallies of non-force (passive) compute power values successes
//	uint32_t tally_pp_f = 0; // Tallies of non-force (passive) compute power values fails
//	uint32_t tally_cp_s = 0; // Tallies successes of getCurrentPowerValue function call
//	uint32_t tally_cp_f = 0; // Tallies fails of getCurrentPowerValue function call
//	double testNormalArray[FILTER_IIRFILTERS];
//	double maxNormal = 0;
//	double currentNormal = 0;
//	uint16_t testIndex = 0;
//
//	for(int j = 0 ; j < FILTER_IIRFILTERS; j++ ) {
//
//		for (int i = 0 ; i < TEST_DATA_COUNT ; i++) {
//
//			queue_overwritePush(&yQueue,iirTestInput[i]);
//			output = filter_iirFilter(j);
//			powerForce = filter_computePower(j, true, false);
//			powerPassive = filter_computePower(j, false, false);
//
//			// Check for zero
//			if(iirTestOutput[j][i] != 0) {
//				IIR_error = (output - iirTestOutput[j][i])/iirTestOutput[j][i];
//			}
//			else {
//				IIR_error = (output - iirTestOutput[j][i]);
//			}
//			if(powerTestForce[j][i] != 0) {
//				powerForce_error = (powerForce - powerTestForce[j][i])/powerTestForce[j][i];
//			}
//			else {
//				powerForce_error = (powerForce - powerTestForce[j][i]);
//			}
//			if(powerTestPassive[j][i]) {
//				powerPassive_error = (powerPassive - powerTestPassive[j][i])/powerTestPassive[j][i];
//			}
//			else {
//				powerPassive_error = (powerPassive - powerTestPassive[j][i]);
//			}
////			printf("%lf - %lf = %lf\r\n",powerForce,powerTestForce[j][i],powerForce_error);
////			printf("%lf - %lf = %lf\r\n",powerPassive,powerTestPassive[j][i],powerPassive_error);
////			printf("Force: %lf  Passive: %lf \r\n",powerForce_error , powerPassive_error);
//			if(!(IIR_error >= EPSILON_NEG && IIR_error <= EPSILON_POS)) {
//				tally_f++;
//				printf("IIR output is %lf and it should be %lf. At index %d\n\r",output, iirTestOutput[j][i], i);
//
//	//			printf("IIR Fail");
//			}
//			else {
//				tally_s++;
//	//			printf("IIR Success\r\n");
//			}
//
//			if(!(powerForce_error >= EPSILON_NEG && powerForce_error <= EPSILON_POS)) {
//				tally_pf_f++;
//			}
//			else {
//				tally_pf_s++;
//			}
//
//			if(!(powerPassive_error >= EPSILON_NEG && powerPassive_error <= EPSILON_POS)) {
//				tally_pp_f++;
//			}
//			else {
//				tally_pp_s++;
//			}
//
//			if(filter_getCurrentPowerValue(j) != powerForce) {
//				tally_cp_f++;
//			}
//			else {
//				tally_cp_s++;
//			}
//
//
//
//
//		}
//		printf("IIR filter %d successes: %ld fails: %ld\r\n",j,tally_s,tally_f);
//		printf("--Force Power filter %d successes: %ld fails: %ld\r\n",j,tally_pf_s,tally_pf_f);
//		printf("--Non-Force Power filter %d successes: %ld fails: %ld\r\n",j,tally_pp_s,tally_pp_f);
//		printf("--getCurrentPowerValue filter %d successes: %ld fails: %ld\r\n",j,tally_cp_s,tally_cp_f);
//		tally_s = 0;
//		tally_f = 0;
//		tally_pf_s = 0;
//		tally_pf_f = 0;
//		tally_pp_s = 0;
//		tally_pp_f = 0;
//		tally_cp_s = 0;
//		tally_cp_f = 0;
//
//	}
//
//	// Normalized Power Value test loop
//	filter_getNormalizedPowerValues(testNormalArray,&testIndex);
//	for (int k = 0 ; k < FILTER_IIRFILTERS ; k++) {
//		currentNormal = testNormalArray[k];
//		if (currentNormal >= maxNormal) {
//			maxNormal = currentNormal;
//			if(k == testIndex) {
//				printf("\r\n--getNormalizedPowerValue function passed\r\n\r\n");
//			}
//		}
//	}
//
//// Measurement of computational time
//	  intervalTimer_initAll();
//	  intervalTimer_resetAll();
//	  intervalTimer_testAll();
//	  static uint32_t timer = 1;	//Timer being used
//	  intervalTimer_reset(timer);
//	  intervalTimer_start(timer);
//	  int countIterations = 10;	//Number of times to run the filters
//
//	  for (int i = 0; i < countIterations ; i++) {
//		  filter_computePower(i, true, false);
//	  }
//	  intervalTimer_stop(timer);
//	  double runningSeconds;
//	  intervalTimer_getTotalDurationInSeconds(1, &runningSeconds);
//	  printf("\r\nTotal run time of forced power computation as measured by interval timer in seconds: %g.\n\r", runningSeconds);
//
//
//	  intervalTimer_resetAll();
//	  intervalTimer_start(timer);
//	  for (int i = 0; i < countIterations ; i++) {
//		  filter_computePower(i, false, false);
//	  }
//	  intervalTimer_getTotalDurationInSeconds(1, &runningSeconds);
//	  printf("Total run time of quick power computation as measured by interval timer in seconds: %g.\n\r\r\n", runningSeconds);
//
//
//// Real input test
//
//	uint32_t selectFilter = 2;  //Select individual filters to test
//	uint32_t testIterateMax = 100;  //Number of inputs to filter
//	printf("\r\nPushing %ld inputs through filter system.\r\n",testIterateMax);
//	printf("--Testing Filter %ld--\r\n",selectFilter);
//	filter_init();
//
//		for(uint32_t i = 0 ; i < testIterateMax ; i++) {
//			filter_addNewInput(firInputTestData[i]);
//			if((i+1)%10 ==0 &&  i !=0) {
//				filter_firFilter();
//
//				for(int j = 0 ; j < FILTER_IIRFILTERS ; j++) {
//					filter_iirFilter(j);
//				}
//			}
//		}
//		printf("\r\n**Compare these values with Excel spreadsheet**\r\n");
//		filter_printYQueue();
//		filter_printZQueue(selectFilter);
//
//
//		if(filter_runFirOnesTest()) {
//			printf("\r\nPassed runFirOnesTest\r\n");
//		}
//		if(filter_runFirOneTest()) {
//			printf("\r\nPassed runFirOneTest\r\n");
//
//		}
//
//
//		// compute power test
//
//		initPower();
//		double thisArray[10];
//		uint16_t indexMax;
//		for(int i = 0 ; i < 2501 ; i++) {
//			queue_overwritePush(&outputQueue[0],5);
//			queue_overwritePush(&outputQueue[1],6);
//			queue_overwritePush(&outputQueue[2],3);
//			queue_overwritePush(&outputQueue[3],2);
//			queue_overwritePush(&outputQueue[4],4);
//			queue_overwritePush(&outputQueue[5],7);
//			queue_overwritePush(&outputQueue[6],9);
//			queue_overwritePush(&outputQueue[7],12);
//			queue_overwritePush(&outputQueue[8],1);
//			queue_overwritePush(&outputQueue[9],8);
//			filter_computePower(0, false, false);
//			filter_computePower(1, false, false);
//			filter_computePower(2, false, false);
//			filter_computePower(3, false, false);
//			filter_computePower(4, false, false);
//			filter_computePower(5, false, false);
//			filter_computePower(6, false, false);
//			filter_computePower(7, false, false);
//			filter_computePower(8, false, false);
//			filter_computePower(9, false, false);
//			filter_getNormalizedPowerValues(thisArray, &indexMax);
////			printf("%lf %lf %lf %lf %lf %lf %lf %lf %lf %lf with normal max at %lf\r\n",filter_getCurrentPowerValue(0),filter_getCurrentPowerValue(1),filter_getCurrentPowerValue(2),filter_getCurrentPowerValue(3),filter_getCurrentPowerValue(4),filter_getCurrentPowerValue(5),filter_getCurrentPowerValue(6),filter_getCurrentPowerValue(7),filter_getCurrentPowerValue(8),filter_getCurrentPowerValue(9),thisArray[indexMax]);
//		}
//
//		for(int i = 0 ; i < 10 ; i++) {
//			printf("player %d: %lf\r\n",i,thisArray[i]);
//		}
//
//
//
//		return true;
//}

/*=============================================================================
 * ================= Test Routines Start Here =================================
 ==============================================================================*/

/* ===================== Test Variable Definitions ==================== */
static uint16_t firDecimationCount = 0;  // Used to keep track of samples relative to the decimation factor.

/* ================================== #defines ================================ */
#define FILTER_IIR_POWER_TEST_PERIOD_COUNT FILTER_FREQUENCY_COUNT
#define FILTER_FREQUENCY_COUNT FILTER_IIR_FILTER_COUNT
#define FILTER_SAMPLE_FREQUENCY_IN_KHZ 100

// NOTE: YOU MUST DEFINE THIS PROPERLY FOR THE TEST TO WORK PROPERLY.
// If you used a leading 1 in the A-coefficient array for your IIR, this should be defined to be a 1.
// If you did not use a leading 1 in the A-coefficient array for your IIR, this should be defined to be 0.
#define FILTER_TEST_USED_LEADING_1_IN_IIR_A_COEFFICIENT_ARRAY 0

/* ===================== Simple Accessor Functions ==================== */

// Returns the array of FIR coefficients.
double* filterTest_getFirCoefficientArray() {
  return firCoefficients;
}

// Returns the number of FIR coefficients.
uint32_t filterTest_getFirCoefficientCount() {
  return FIR_FILTER_TAP_COUNT;
}

// Returns the array of coefficients for a particular filter number.
double* filterTest_getIirACoefficientArray(uint16_t filterNumber) {
  return  iirCoefficientsA[filterNumber];
}

// Returns the number of A coefficients.
uint32_t filterTest_getIirACoefficientCount() {
  return IIR_COEFFICIENT_COUNT-1;
}

// Returns the array of coefficients for a particular filter number.
double* filterTest_getIirBCoefficientArray(uint16_t filterNumber) {
  return  iirCoefficientsB[filterNumber];
}

// Returns the number of B coefficients.
uint32_t filterTest_getIirBCoefficientCount() {
  return IIR_COEFFICIENT_COUNT;
}

// Returns the size of the yQueue.
uint32_t filterTest_getYQueueSize() {
  return Y_QUEUE_SIZE;
}

// Returns the decimation value.
uint16_t filterTest_getDecimationValue() {
  return FILTER_FIR_DECIMATION_FACTOR;
}

// Returns the starting index for the A-coefficient array for the IIR-filter.
// Some students use the leading 1, others did not.
uint16_t filterTest_getIirACoefficientArrayStartingIndex() {
  if (FILTER_TEST_USED_LEADING_1_IN_IIR_A_COEFFICIENT_ARRAY)
    return 1;
  else
    return 0;
}

/*==========================Helper Test Functions ============================ */

// Returns true if the values are within TEST_FILTER_FLOATING_POINT_EPSILON of each other.
//#define TEST_FILTER_FLOATING_POINT_EPSILON 1.0E-15L
static const double eps = 1.0E-15;
bool filterTest_floatingPointEqual(double a, double b) {
   return fabs(a-b) < eps;
}

// Fills the queue with the fillValue, overwriting all previous contents.
void filterTest_fillQueue(queue_t* q, double fillValue) {
  for (queue_size_t i=0; i<q->size; i++) {
    queue_overwritePush(q, fillValue);
  }
}

queue_data_t filterTest_filter_readMostRecentValueFromQueue(queue_t* q) {
  return queue_readElementAt(q, q->elementCount-1);
}

/* ============================ Major Test Functions ============================= */

// Invokes FIR-filter according to the decimation factor.
// Returns true if it invokes filter_firFilter().
bool filter_decimatingFirFilter() {
  if (firDecimationCount == filterTest_getDecimationValue()-1) {  // Time to run the FIR filter?
    filter_firFilter();      // Run the FIR filter.
    firDecimationCount = 0;  // Reset the decimation count.
    return true;             // Return true because you ran the FIR filter.
  }
  firDecimationCount++;  // Increment the decimation count each time you call this filter.
  return false;          // Didn't run the FIR filter.
}

// Pushes a single 1.0 through the xQueue. Golden output data are just the FIR coefficients in reverse order.
// If this test passes, you are multiplying the coefficient with the correct element of xQueue.
bool filterTest_runFirAlignmentTest(bool printMessageFlag) {
  bool success = true;	 					// Be optimistic.
  filterTest_fillQueue(&xQueue, 0.0);	// zero-out the xQueue.
  filter_addNewInput(1.0);				// Place a single 1.0 in the xQueue.
  for (uint32_t i=0; i<filterTest_getFirCoefficientCount(); i++) {	// Push the single 1.0 through the queue.
    filter_firFilter();								// Run the FIR filter.
    double firValue = filterTest_filter_readMostRecentValueFromQueue(&yQueue);
    double firGoldenOutput =  filterTest_getFirCoefficientArray()[filterTest_getFirCoefficientCount()-i-1];	// Golden output is simply the FIR coefficient.
    if (!filterTest_floatingPointEqual(firValue, firGoldenOutput)) {	// If the output from the FIR filter does not match the golden value, print an error.
      success = false;									// The test failed.
      printf("filter_runAlignmentTest: Output from FIR Filter(%le) does not match test-data(%le).\n\r", firValue, firGoldenOutput);
    }
    filter_addNewInput(0.0);	// Shift the 1.0 value over one position in the queue.
  }
  // Print informational messages.
  if (printMessageFlag) {
    printf("filter_runFirAlignmentTest ");
    if (success)
      printf("passed.\n\r");
    else
      printf("failed.\n\r");
  }
  return success;	// Return the success of failure of this test.
}

// Fills the xQueue with 1.0. Invokes filter_firFilter() and compares the output with the
// sum of the coefficients.
bool filterTest_runFirArithmeticTest(bool printMessageFlag) {
  bool success = true;							// Be optimistic.
  filterTest_fillQueue(&xQueue, 0.0);  // zero-out the xQueue.
  double firGoldenOutput = 0.0;			          // You will compute the golden output by accumulating the FIR coefficients.
  for (uint32_t i=0; i<filterTest_getFirCoefficientCount(); i++) {	// Loop enough times to go through the coefficients.
    firGoldenOutput += filterTest_getFirCoefficientArray()[i];
  }
  filterTest_fillQueue(&xQueue, 1.0);
  filter_firFilter();
  double firValue = filterTest_filter_readMostRecentValueFromQueue(&yQueue);
  if (!filterTest_floatingPointEqual(firValue, firGoldenOutput)) {
    success = false;									// Test failed.
    printf("filter_runArithmeticTest: Output from FIR Filter(%le) does not match test-data(%le).\n\r", firValue, firGoldenOutput);
  }
  // Print informational messages.
  if (printMessageFlag) {
    printf("filter_runFirArithmeticTest ");
    if (success)
      printf("passed.\n\r");
    else
      printf("failed.\n\r");
  }
  return success;	// Return the success or failure of the test.
}

// This test checks to see that the B coefficients are multiplied with the correct values of the yQueue.
// If it passes, the coefficients are properly aligned with the data in yQueue.
// This test only checks the coefficients for filterNumber (frequency).
bool filterTest_runIirBAlignmentTest(uint16_t filterNumber, bool printMessageFlag) {
  bool success = true;						// Be optimistic.
  filterTest_fillQueue(&yQueue, 0.0);	// zero-out the yQueue.
  filterTest_fillQueue(&(zQueue[filterNumber]), 0.0);	// zero out the zQueue for filterNumber.
  queue_overwritePush(&yQueue, 1.0);							// Place a single 1.0 in the yQueue.
  for (uint32_t i=0; i<filterTest_getIirBCoefficientCount(); i++) {
    filter_iirFilter(filterNumber);										// Run the IIR filter.
    double iirValue = filterTest_filter_readMostRecentValueFromQueue(&(zQueue[filterNumber]));										// Run the IIR filter.
    double iirGoldenOutput =  filterTest_getIirBCoefficientArray(filterNumber)[i];	// Golden output is simply the coefficient.
    if (!filterTest_floatingPointEqual(iirValue, iirGoldenOutput)) {	// Make sure they IIR output matches the golden output.
      success = false;									// Note test failure and print message.
      printf("filter_runIirBlignmentTest: Output from IIR Filter[%d](%le) does not match test-data(%le) at index(%ld).\n\r", filterNumber, iirValue, iirGoldenOutput, i);
    }
    filterTest_fillQueue(&(zQueue[filterNumber]), 0.0);	// zero out the zQueue for filterNumber so the A-summation is always 0.
    queue_overwritePush(&yQueue, 0.0);							// Shift the 1.0 over one position in the yQueue.
  }
  // Print informational messages.
  if (printMessageFlag) {
    printf("filter_runIirBAlignmentTest ");
    if (success)
      printf("passed.\n\r");
    else
      printf("failed.\n\r");
  }
  return success;	// Return the success or failure of the test.
}

// Checks to see that the A-coefficients are properly aligned with the zQueue.
// This test checks the A-coefficients for a specific filter-number (frequency).
// It is a little more work to create a sliding 1 in the zQueue because the IIR updates the zQueue.
// Thus as you move across coefficients, the zQueue is cleared out. 1.0 is added and shifted over the correct number of spaces.
bool filterTest_runIirAAlignmentTest(uint16_t filterNumber, bool printMessageFlag) {
  bool success = true;						// Be optimistic.
  filterTest_fillQueue(&yQueue, 0.0);	// zero-out the yQueue so the B-summation is always 0.
  uint16_t startingIndex = filterTest_getIirACoefficientArrayStartingIndex();  // Varies according to student.
  for (uint32_t i=0; i<filterTest_getIirACoefficientCount()-startingIndex; i++) {	// Loop through all of the A-coefficients.
    filterTest_fillQueue(&(zQueue[filterNumber]), 0.0);				// zero out the zQueue for filterNumber.
    queue_overwritePush(&(zQueue[filterNumber]), 1.0);		// Add a single 1.0 to the queue.
    for (uint32_t j=0; j<i; j++) {												// Move over the 1.0 an additional position each time through the loop.
      queue_overwritePush(&(zQueue[filterNumber]), 0.0);	// Move the 1.0 over by writing the correct number of zeros.
    }
    filter_iirFilter(filterNumber);										// Run the IIR filter.
    double iirValue = filterTest_filter_readMostRecentValueFromQueue(&(zQueue[filterNumber]));										// Run the IIR filter.
    double iirGoldenOutput =  filterTest_getIirACoefficientArray(filterNumber)[i+startingIndex];	// Golden output is simply the coefficient.
    if (!filterTest_floatingPointEqual(iirValue, -iirGoldenOutput)) {							// Check to see that the IIR-output matches the correct coefficient value.
      success = false;																									// Note the failure of the test and print an info message.
      printf("filter_runIirAlignmentTest: Output from IIR Filter[%d](%le) does not match test-data(%le) at index(%ld).\n\r", filterNumber, iirValue, iirGoldenOutput, i);
    }
  }
  // Print informational messages.
  if (printMessageFlag) {
    printf("filter_runIirAAlignmentTest ");
    if (success)
      printf("passed.\n\r");
    else
      printf("failed.\n\r");
  }
  return success;	// Return the failure or success of the test.
}

// Normalizes the values in the array argument.
void filterTest_normalizeArrayValues(double* array, uint16_t size) {
  // Find the maximum value
  uint16_t maxIndex = 0;
  // Find the index of the max value in the array.
  for (int i=0; i<size; i++) {
    if (array[i] > array[maxIndex])
      maxIndex = i;
  }
  double maxPowerValue = array[maxIndex];
  // Normalize everything between 0.0 and 1.0, based upon the max value.
  for (int i=0; i<size; i++)
    array[i] = array[i] / maxPowerValue;
}

#define FILTER_FIR_POWER_TEST_PERIOD_COUNT 22
#define FILTER_TEST_HISTOGRAM_BAR_COUNT FILTER_FIR_POWER_TEST_PERIOD_COUNT
// Everything is defined assuming a 100 kHz sample rate.
static const uint16_t filter_testPeriodTickCounts[FILTER_FIR_POWER_TEST_PERIOD_COUNT] = {90, 72, 58, 50, 44, 38, 34, 30, 28, 26, 24, 22, 20, 18, 16, 14, 12, 10, 8, 6, 4, 2};
#define MAX_BUF 10
#define FILTER_TEST_PULSE_WIDTH_LENGTH 20000

// Plots the frequency response of the FIR filter on the TFT.
// Everything is defined assuming a 100 kHz sample rate.
// Frequencies run from 1.1 kHz to 50 kHz.
void filterTest_runFirPowerTest(bool printMessageFlag) {
  if (printMessageFlag) {
    // Tells you that this function is plotting the frequency response for the FIR filter for a set of frequencies.
    printf("running filter_runFirPowerTest() - plotting power values (frequency response) for frequencies %1.2lf kHz to %1.2lf kHz for FIR filter to TFT display.\n\r",
	   ((double) ((FILTER_SAMPLE_FREQUENCY_IN_KHZ))/filter_testPeriodTickCounts[0]),
	   ((double) ((FILTER_SAMPLE_FREQUENCY_IN_KHZ))/filter_testPeriodTickCounts[FILTER_FIR_POWER_TEST_PERIOD_COUNT-1]));
  }
  firDecimationCount = 0;
  double testPeriodPowerValue[FILTER_FIR_POWER_TEST_PERIOD_COUNT];	// Computed power values will go here.
  uint16_t freqCount=0;	// Used to print info message.
  // Simulate running everything at 100 kHz. Simply add either 1.0 or -1.0 to xQueue based upon the
  // the frequency you are simulating.
  // Iterate over all of the test-periods.
  for (uint16_t testPeriodIndex=0; testPeriodIndex<FILTER_FIR_POWER_TEST_PERIOD_COUNT; testPeriodIndex++) {
    uint16_t currentPeriodTickCount = filter_testPeriodTickCounts[testPeriodIndex];
    double power = 0.0;						// Temp variable to compute power.
    uint32_t totalTickCount = 0;	// Keep track of where you are in the period.
    while (totalTickCount < FILTER_TEST_PULSE_WIDTH_LENGTH) {	// Keep going until you have completed the entire pulse-width.
      for (uint16_t freqTick = 0; freqTick < currentPeriodTickCount; freqTick++) {	// This loop completes a single period.
	if (freqTick < currentPeriodTickCount/2)	// The first half of the period is -1.0.
	  filter_addNewInput(-1.0);		// Add the simulated value to the FIR filter.
	else
	  filter_addNewInput(+1.0);		// In the second half of the period, add +1.0 to the FIR filter.
	if (filter_decimatingFirFilter()) {	// Tells us if we ran the the FIR filter (we are decimating so the FIR filter only runs every 10 input values).
	  double firOutput = filterTest_filter_readMostRecentValueFromQueue(&yQueue);	// Get the output from the yQueue.
	  power += firOutput * firOutput;	// Compute the power so far.
	  totalTickCount++;
	}
      }
    }
    testPeriodPowerValue[testPeriodIndex] = power;	// All done computing power for this period, move on to the next one.
    //		printf("Frequency[%d](%5.4lf) Power:%5.2le\n\r", freqCount, (double) (FILTER_SAMPLE_FREQUENCY_IN_KHZ/currentPeriodTickCount), power);
    freqCount++;
  }
  // Now we start plotting the results.
  filterTest_normalizeArrayValues(testPeriodPowerValue, FILTER_FIR_POWER_TEST_PERIOD_COUNT);	// Normalize the values.
  histogram_init(FILTER_TEST_HISTOGRAM_BAR_COUNT);	// Init the histogram.
  // Set labels and colors (blue) for the standard frequencies 0-9.
  for (int i=0; i<FILTER_FREQUENCY_COUNT; i++) {
    histogram_setBarColor(i, DISPLAY_BLUE);		// Sets the color of the bar.
    char tempLabel[MAX_BUF];									// Temp variable for label generation.
    snprintf(tempLabel, MAX_BUF, "%d", i);		// Create the label that represents one of the user frequencies.
    histogram_setBarLabel(i, tempLabel);			// Finally, set the label.
  }
  // Set the colors for the other nonstandard frequencies to be red so that the stand out.
  for (int i=10; i<FILTER_FIR_POWER_TEST_PERIOD_COUNT; i++) {
    histogram_setBarColor(i, DISPLAY_RED);
    char tempLabel[MAX_BUF];	// Used to create labels.
    // Create three kinds of labels.
    // 1. Just label the first set of defined frequencies 0-9.
    // 2. This is the start of the frequencies outside the actual transmitted frequencies.
    // The bounds are printed at the start and end of this range, using the labels so that they display OK in the limited space.
    // 3. The lower bound for out-of-bound testing frequencies.
    if (i == 10) {
      snprintf(tempLabel, MAX_BUF, "%dkHz",  FILTER_SAMPLE_FREQUENCY_IN_KHZ/filter_testPeriodTickCounts[i]);
      histogram_setBarLabel(i, tempLabel);
      // 4. Print the upper bound for out-of-bound testing frequencies further to the left to make readable.
    } else if (i == FILTER_FIR_POWER_TEST_PERIOD_COUNT-4) {
      snprintf(tempLabel, MAX_BUF, "%dkHz",  FILTER_SAMPLE_FREQUENCY_IN_KHZ/filter_testPeriodTickCounts[FILTER_FIR_POWER_TEST_PERIOD_COUNT-1]);
      histogram_setBarLabel(i, tempLabel);
      // Print a "-" for readability.
    } else if (i == FILTER_FIR_POWER_TEST_PERIOD_COUNT-7) {
      histogram_setBarLabel(i, "-");
      // Print blank space everywhere else.
    } else {
      histogram_setBarLabel(i, "");

    }
  }
  // Set the actual histogram-bar data to be power values..
  for (uint16_t barIndex=0; barIndex<FILTER_TEST_HISTOGRAM_BAR_COUNT; barIndex++) {
    histogram_setBarData(barIndex, testPeriodPowerValue[barIndex] * HISTOGRAM_MAX_BAR_DATA_IN_PIXELS, "");
  }
  histogram_redrawBottomLabels();  // Need to redraw the bottom labels because I changed the colors.
  histogram_updateDisplay();	   // Redraw the histogram.
}

// Plots frequency response for the selected filterNumber against the 10 standard frequencies.
void filterTest_runIirPowerTest(uint16_t filterNumber, bool printMessageFlag) {
  if (printMessageFlag) {
    printf("running filter_runFirPowerTest(%d) - plotting power for all player frequencies for IIR filter(%d) to TFT display.\n\r", filterNumber, filterNumber);
  }
  firDecimationCount = 0;
  double testPeriodPowerValue[FILTER_IIR_POWER_TEST_PERIOD_COUNT];	// Keep track of power values here.
  uint16_t freqCount=0;
  // Simulate running everything at 100 kHz.
  for (uint16_t testPeriodIndex=0; testPeriodIndex<FILTER_FREQUENCY_COUNT; testPeriodIndex++) {  // Only use the first 10 standard frequencies.
    uint16_t currentPeriodTickCount = filter_testPeriodTickCounts[testPeriodIndex];		// You will be generating a frequency with this period.
    double power = 0.0;						// Used to compute power.
    uint32_t totalTickCount = 0;	// Keep track of where you are in the given period.
    while (totalTickCount < FILTER_TEST_PULSE_WIDTH_LENGTH) {		// Generate a pulse-width of periods.
      double iirOutput = 0.0;		// Output from the IIR filter.
      for (uint16_t freqTick = 0; freqTick < currentPeriodTickCount; freqTick++) {	// This loop generates one period of the frequency.
	if (freqTick < currentPeriodTickCount/2)	// First half of period is -1.0.
	  filter_addNewInput(-1.0);
	else
	  filter_addNewInput(+1.0);								// Second half of period is +1.0
	if (filter_decimatingFirFilter()) {				// If you actually ran the FIR-filter, run the IIR-filter.
	  filter_iirFilter(filterNumber);
	  iirOutput = filterTest_filter_readMostRecentValueFromQueue(&(zQueue[filterNumber]));
	}
	power += iirOutput * iirOutput;	// Compute the power at the output.
	totalTickCount++;
      }
    }
    testPeriodPowerValue[testPeriodIndex] = power;
    //		printf("Frequency[%d](%5.4lf) Power:%5.2le\n\r", freqCount, (double) (FILTER_SAMPLE_FREQUENCY_IN_KHZ/currentPeriodTickCount), power);
    freqCount++;
  }
  // Make a copy of the power values that you will normalize.
  double normalizedPowerValue[FILTER_IIR_POWER_TEST_PERIOD_COUNT];
  for (int i=0; i<FILTER_IIR_POWER_TEST_PERIOD_COUNT; i++) {
    normalizedPowerValue[i] = testPeriodPowerValue[i];
  }
  filterTest_normalizeArrayValues(normalizedPowerValue, FILTER_IIR_POWER_TEST_PERIOD_COUNT);
  histogram_init(FILTER_IIR_POWER_TEST_PERIOD_COUNT);
  // Set labels and colors (red) for the standard frequencies 0-9.
  // Default is red but will change the color for the desired frequency to be blue.
  for (int i=0; i<FILTER_IIR_POWER_TEST_PERIOD_COUNT; i++) {
    histogram_setBarColor(i, DISPLAY_RED);
    char tempLabel[MAX_BUF];
    snprintf(tempLabel, MAX_BUF, "%d", i);
    histogram_setBarLabel(i, tempLabel);
  }
  histogram_setBarColor(filterNumber, DISPLAY_BLUE);	// Desired frequency drawn in blue.
  for (uint16_t barIndex=0; barIndex<FILTER_IIR_POWER_TEST_PERIOD_COUNT; barIndex++) {
    char label[HISTOGRAM_BAR_TOP_MAX_LABEL_WIDTH_IN_CHARS];	// Get a buffer for the label.
    // Create the top-label, based upon the actual power value.
    if (snprintf(label, HISTOGRAM_BAR_TOP_MAX_LABEL_WIDTH_IN_CHARS, "%0.0e", testPeriodPowerValue[barIndex]) == -1)
      printf("Error: snprintf encountered an error during conversion.\n\r");
    // Pull out the 'e' from the exponent to make better use of your characters.
    trimLabel(label);
    histogram_setBarData(barIndex, normalizedPowerValue[barIndex] * HISTOGRAM_MAX_BAR_DATA_IN_PIXELS, label);	// No top-label.
  }
  histogram_redrawBottomLabels();  // Need to redraw the bottom labels because I changed the colors.
  histogram_updateDisplay();	   // Redraw the histogram.
}

// 1. Tests the FIR filter in isolation using test-data, with no decimation.
// 2. Tests the FIR-filter using actual data, with decimation, using data generated by the transmitter code but not going
// through the ADC. The data generated by the transmitter are scaled between -1.0 and 1.0 and placed directly in the xQueue.
// The power in the FIR output is measured and compared to a threshold.
// 3. Tests the IIR in isolation using test-data.
// 4. Tests the
#define TEN_SECONDS 10000
#define TWO_SECONDS 2000
bool filter_runTest() {
  bool success = true;	// Be optimistic.
  filter_init();
  success &= filterTest_runFirAlignmentTest(true);
  success &= filterTest_runFirArithmeticTest(true);
  success &= filterTest_runIirAAlignmentTest(0, true);
  success &= filterTest_runIirBAlignmentTest(0, true);
  filterTest_runFirPowerTest(true);
  utils_msDelay(TEN_SECONDS);
  for (int i=0; i<FILTER_IIR_FILTER_COUNT; i++) {
    filterTest_runIirPowerTest(i, true);
    utils_msDelay(TWO_SECONDS);
  }
  return success;
}

